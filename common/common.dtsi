/* Copyright (c) 2016, Motorola Mobility Inc. All rights reserved.
 *
 * This program is free software; you can redistribute it and/or modify
 * it under the terms of the GNU General Public License version 2 and
 * only version 2 as published by the Free Software Foundation.
 *
 * This program is distributed in the hope that it will be useful,
 * but WITHOUT ANY WARRANTY; without even the implied warranty of
 * MERCHANTABILITY or FITNESS FOR A PARTICULAR PURPOSE.  See the
 * GNU General Public License for more details.
 */

/* Moto */

// TODO: Handle IS_MSM8917 and IS_MSM8920
#if defined(IS_MSM8940)
#include "qcom/msm8940.dtsi"
#else
#include "qcom/msm8937.dtsi"
#endif

#include "qcom/msm-pmi8950.dtsi"

#ifdef IS_MSM8917
#include "qcom/msm8917-pinctrl.dtsi"
#else
#include "qcom/msm8937-pinctrl.dtsi"
#endif

#include "carrier-channel-ids.dtsi"
#include "dsi-panel-mot-dummy-qhd-video.dtsi"
#include "include/moto-mem-reserve.h"

/* Custom */

#include "pinctrl.dtsi"

#include "android.dtsi"
#include "audio.dtsi"
#include "battery.dtsi"
#include "bus.dtsi"
#include "display.dtsi"
#include "misc.dtsi"
#include "pmi8950.dtsi"
#include "regulator.dtsi"
#include "reserved-memory.dtsi"
#include "soc.dtsi"
#include "storage.dtsi"
#include "thermal.dtsi"

#include "peripheral/peripheral.dtsi"
